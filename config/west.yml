## config/west.yml
```yaml
manifest:
  defaults:
    revision: main # version to use for this module and for ZMK
  remotes:
  - name: zmkfirmware
    url-base: https://github.com/zmkfirmware
  projects:
  - name: zmk
    remote: zmkfirmware
    import: app/west.yml
  - name: zmk-adaptive-key
    url: https://github.com/urob/zmk-adaptive-key
    path: modules/zmk-adaptive-key
  self:
    path: config
```
